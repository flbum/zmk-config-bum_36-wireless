## boards/shields/b36w/Kconfig.shield
```kconfig
config SHIELD_B36W_LEFT
    def_bool $(shields_list_contains,b36w_left)

config SHIELD_B36W_RIGHT
    def_bool $(shields_list_contains,b36w_right)
```
